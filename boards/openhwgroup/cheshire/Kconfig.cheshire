## boards/openhwgroup/cheshire/Kconfig.cheshire
```kconfig
# Copyright 2024 ETH Zurich
# SPDX-License-Identifier: Apache-2.0
config BOARD_CHESHIRE
	select SOC_CV64A6_IMAFDC
```

## boards/openhwgroup/cheshire/board.yml
```yaml
# Copyright 2024 CISPA Helmholtz Center for Information Security gGmbH
# SPDX-License-Identifier: Apache-2.0
board:
  name: cheshire
  full_name: ETH Cheshire RISC-V SoC
  vendor: ethz
  socs:
    - name: cv64a6_imafdc
      variants:
        - name: s_mode
```

## boards/openhwgroup/cheshire/cheshire_defconfig
```kconfig
# Copyright 2024 ETH Zurich
# SPDX-License-Identifier: Apache-2.0
CONFIG_INCLUDE_RESET_VECTOR=y
CONFIG_CONSOLE=y
CONFIG_SERIAL=y
CONFIG_UART_CONSOLE=y
CONFIG_UART_NS16550_ACCESS_WORD_ONLY=y
CONFIG_CONSOLE_HANDLER=y
CONFIG_XIP=n

CONFIG_USERSPACE=n
CONFIG_THREAD_MONITOR=n
# enable the SBI support
# CONFIG_RISCV_SBI_BOOT=y
# Run zephyr in Supervisor mode
# CONFIG_RISCV_S_MODE=y
# CONFIG_RISCV_MACHINE_TIMER=n
# CONFIG_RISCV_SUPERVISOR_TIMER=y
```

## drivers/ethernet/Kconfig.lowrisc
```kconfig
# LowRISC Ethernet driver configuration

# Copyright (c) 2024 ETH Zurich and University of Bologna
# SPDX-License-Identifier: Apache-2.0

menuconfig ETH_LOWRISC
	bool "LowRISC 100MHz Ethernet driver"
	default y
	depends on DT_HAS_LOWRISC_ETH_ENABLED
	depends on NET_L2_ETHERNET
	help
	  Enable the LowRISC 100MHz Ethernet MAC driver.
	  This IP core uses memory-mapped TX/RX buffers and MDIO
	  bitbang for PHY management. Commonly found on Cheshire
	  and other PULP-based RISC-V platforms.

if ETH_LOWRISC

config ETH_LOWRISC_RX_THREAD_STACK_SIZE
	int "RX thread stack size"
	default 2048
	help
	  Stack size for the Ethernet RX processing thread.

config ETH_LOWRISC_RX_THREAD_PRIORITY
	int "RX thread priority"
	default 2
	help
	  Priority for the Ethernet RX processing thread.
	  Lower numbers are higher priority.

endif # ETH_LOWRISC
```

## drivers/virtio/Kconfig
```kconfig
# Copyright (c) 2024 Antmicro <www.antmicro.com>
# SPDX-License-Identifier: Apache-2.0

config VIRTIO
	bool "support for VIRTIO"
	help
	  Enable options for VIRTIO

if VIRTIO

module = VIRTIO
module-str = VIRTIO
source "subsys/logging/Kconfig.template.log_config"

config VIRTIO_PCI
	bool "support for VIRTIO over PCI"
	default y
	depends on DT_HAS_VIRTIO_PCI_ENABLED
	help
	  Enable options for VIRTIO over PCI

config VIRTIO_MMIO
	bool "support for VIRTIO over MMIO"
	default y
	depends on DT_HAS_VIRTIO_MMIO_ENABLED
	help
	  Enable options for VIRTIO over MMIO
config VIRTIO_SHM_ALLOC
    bool "Use shared memory allocator for virtio buffers"
    default n
    help
      Use a bump allocator over a reserved shared memory region
      for virtio queue and data buffers. Required when running
      as a frontend VM under Bao hypervisor with remoteio.

endif # VIRTIO
```

## dts/bindings/ethernet/lowrisc,eth.yaml
```yaml
# Copyright (c) 2024 ETH Zurich and University of Bologna
# SPDX-License-Identifier: Apache-2.0

description: |
  LowRISC 100MHz Ethernet MAC controller.

  This is a simple memory-mapped Ethernet controller with:
    - TX buffer at offset 0x1000
    - RX buffers (8 slots) at offset 0x4000
    - 64-bit register access
    - MDIO bitbang PHY interface
    - Single RX interrupt

  Commonly used on Cheshire and other PULP-based RISC-V SoCs.

  Example devicetree node:

    eth: ethernet@3010000 {
        compatible = "lowrisc,eth";
        reg = <0x0 0x3010000 0x0 0x10000>;
        interrupt-parent = <&plic>;
        interrupts = <58 4>;
        local-mac-address = [00 18 3e 02 e3 7f];
        status = "okay";
    };

compatible: "lowrisc,eth"

include: [base.yaml, ethernet-controller.yaml]

properties:
  reg:
    required: true

  interrupts:
    required: true

  local-mac-address:
    type: uint8-array
    description: |
      The 6-byte MAC address assigned to this interface.
      If not specified, the driver will attempt to read
      the MAC address programmed by the bootloader.
```

## dts/bindings/virtio/virtio,mmio.yaml
```yaml
# Copyright (c) 2025 TOKITA Hiroshi
# SPDX-License-Identifier: Apache-2.0

description: VIRTIO over MMIO

compatible: "virtio,mmio"

include: [base.yaml]

properties:
  memory-region:
    type: phandles
    required: false
    description: |
      Reference to a reserved memory region for shared virtio buffers.
```
